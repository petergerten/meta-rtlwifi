## conf/layer.conf
```bitbake
# Append conf dir to BBPATH
BBPATH .= ":${LAYERDIR}"

# Append recipe dir to BBFILES
BBFILES += "${LAYERDIR}/recipes*/*/*.bb ${LAYERDIR}/recipes*/*/*.bbappend"

LAYERSERIES_COMPAT_rtlwifi = "rocko sumo thud"

BBFILE_COLLECTIONS += "rtlwifi"
BBFILE_PRIORITY_rtlwifi = "1"
BBFILE_PATTERN_rtlwifi = "${LAYERDIR}"


# We're good with rocko, not that it's checking for this...sumo and beyond is...
LAYERVERSION_rtlwifi = "1"
LAYERDEPENDS_rtlwifi = "core"
LAYERSERIES_COMPAT_rtlwifi = "rocko sumo thud warrior"
```
